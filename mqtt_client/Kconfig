## mqtt_client/Kconfig
```kconfig
menu "MQTT Client Configuration"

    config OW_MQTT_CLIENT_ENABLE
        bool "Enable MQTT Client"
        default n
        help
            Enables the MQTT client to connect to an MQTT broker.

    if OW_MQTT_CLIENT_ENABLE

        config OW_MQTT_BROKER_URI
            string "MQTT Broker URI"
            default "mqtt://192.168.1.100"
            help
                URI of the MQTT broker (e.g., mqtt://192.168.1.100:1883).
                Only unencrypted mqtt:// connections are supported.
                TLS (mqtts://) is not supported. Credentials and messages
                are transmitted without encryption.

        config OW_MQTT_USERNAME
            string "MQTT Username"
            default ""
            help
                Username for MQTT broker authentication. Leave empty if not required.

        config OW_MQTT_PASSWORD
            string "MQTT Password"
            default ""
            help
                Password for MQTT broker authentication. Leave empty if not required.

        config OW_MQTT_CLIENT_ID
            string "MQTT Client ID"
            default "esp32_client"
            help
                Unique client ID for the MQTT connection.

        config OW_MQTT_STATUS_TOPIC
            string "Status Topic"
            default "esp32/status"
            help
                Topic for publishing online/offline status (availability).
                The client will publish "online" when connected and the broker
                will automatically publish "offline" if the connection is lost (last will at unexpected disconnect).

    endif

endmenu
```

## wifi_sta/Kconfig
```kconfig
menu "WiFi STA Configuration"
	config WIFI_STA_CONNECT
        bool "Connect using WiFi"
        default n
        help
            Enables the WiFi driver to connect to your local network.

    if WIFI_STA_CONNECT
		config WIFI_STA_SSID
			string "WiFi SSID"
			default "your-ssid"
			help
				The SSID of the WiFi network to connect to.

		config WIFI_STA_PASSWORD
			string "WiFi Password"
			default "your-password"
			help
				The password of the WiFi network to connect to.
				
		config WIFI_STA_HOSTNAME
            string "WiFi Hostname"
            default "esp32-wifi"
            help
                Hostname for the ESP32 device. This will be used for:
                - mDNS (device.local)
                - DHCP hostname
                - Network identification

    endif				
endmenu
```
